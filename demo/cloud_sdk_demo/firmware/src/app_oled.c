/*******************************************************************************
  MPLAB Harmony Application Source File

  Company:
    Microchip Technology Inc.

  File Name:
    app_oled.c

  Summary:
    This file contains the source code for the MPLAB Harmony application.

  Description:
    This file contains the source code for the MPLAB Harmony application.  It
    implements the logic of the application's state machine and it may call
    API routines of other MPLAB Harmony modules in the system, such as drivers,
    system services, and middleware.  However, it does not call any of the
    system interfaces (such as the "Initialize" and "Tasks" functions) of any of
    the modules in the system or make any assumptions about when those functions
    are called.  That is the responsibility of the configuration-specific system
    files.
 *******************************************************************************/
#include "app_oled.h"
#include "app_common.h"
#include "system/console/sys_console.h"
#include "OLEDB.h"

// *****************************************************************************

/* Wi-Fi icon only */
const uint8_t msgWifiConnected [] = {
    0x00, 0x00, 0xFE, 0xFE, 0xFE, 0x0E, 0x0E, 0x0E, 0x0E, 0x0E, 0x0E, 0x0E, 0x0E, 0x0E, 0x0E, 0x0E,
    0x0E, 0x0E, 0x0E, 0x0E, 0x0E, 0x0E, 0x0E, 0x0E, 0x0E, 0x0E, 0x0E, 0x0E, 0x0E, 0x0E, 0x0E, 0x0E,
    0x0E, 0x0E, 0x0E, 0x0E, 0x0E, 0x0E, 0x0E, 0x0E, 0x0E, 0x0E, 0x0E, 0x0E, 0x0E, 0x0E, 0x0E, 0x0E,
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    0x70, 0x70, 0x70, 0x70, 0x70, 0x70, 0x70, 0x70, 0x70, 0x70, 0x70, 0x7F, 0x7F, 0x7F, 0x00, 0x00
};

/* Wi-Fi and cloud icons */
const uint8_t msgCloudConnected [] = {
    0x00, 0x00, 0xFE, 0xFE, 0xFE, 0x0E, 0x0E, 0x0E, 0x0E, 0x0E, 0x0E, 0x0E, 0x0E, 0x0E, 0x0E, 0x0E,
    0x0E, 0x0E, 0x0E, 0x0E, 0x0E, 0x0E, 0x0E, 0x0E, 0x0E, 0x0E, 0x0E, 0x0E, 0x0E, 0x0E, 0x0E, 0x0E,
    0x0E, 0x0E, 0x0E, 0x0E, 0x0E, 0x0E, 0x0E, 0x0E, 0x0E, 0x0E, 0x0E, 0x0E, 0x0E, 0x0E, 0x0E, 0x0E,
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    0x70, 0x70, 0x70, 0x70, 0x70, 0x70, 0x70, 0x70, 0x70, 0x70, 0x70, 0x7F, 0x7F, 0x7F, 0x00, 0x00
};
// *****************************************************************************
bool loopbackTest(){
    bool ret = false;
    
    /* TX/RX & AN/INT pins loop-back test */
    GPIO_RK7_Clear();
    GPIO_RA13_Clear();
    vTaskDelay(5 / portTICK_PERIOD_MS);
    if(GPIO_RB9_Get() == 0 && GPIO_RA14_Get() == 0){
        GPIO_RK7_Set();
        GPIO_RA13_Set();
        vTaskDelay(5 / portTICK_PERIOD_MS);
        if(GPIO_RB9_Get() == 1 && GPIO_RA14_Get() == 1){
            GPIO_RK7_Clear();
            GPIO_RA13_Clear();
            vTaskDelay(5 / portTICK_PERIOD_MS);
            if(GPIO_RB9_Get() == 0 && GPIO_RA14_Get() == 0){
                ret = true;
            }
        }
    }  
    return ret;
}

// *****************************************************************************
/* Wi-Fi or cloud state change notification*/
void APP_OLEDNotify ( APP_OLED_NOTIFY_TYPE type, bool val)
{
    if(type == APP_OLED_PARAM_WIFI || type == APP_OLED_PARAM_CLOUD)
    {
        appOLEDData.wifiCloudConnected[type] = val;
        appOLEDData.state = APP_OLED_STATE_RUNNING;
    }
}

void APP_OLED_Initialize ( void )
{
    appOLEDData.state = APP_OLED_STATE_INIT;
    appOLEDData.wifiCloudConnected[0] = false;
    appOLEDData.wifiCloudConnected[1] = false;
    appOLEDData.loopback = false;
}

/* Application OLED main task */
void APP_OLED_Tasks( void )
{

    /* Check the application's current state. */
    switch ( appOLEDData.state )
    {
        case APP_OLED_STATE_INIT:
        {
            if (0 == oledb_initialize(&appOLEDData.loopback))
            {
                appOLEDData.state = APP_OLED_STATE_IDLE;
            }
            
            appOLEDData.loopback &= loopbackTest();
            break;
        }
        
        case APP_OLED_STATE_IDLE:
        {
            break;
        }
        
        case APP_OLED_STATE_RUNNING:
        {
            /* Display both Wi-Fi & Cloud icons */
            if(appOLEDData.wifiCloudConnected[APP_OLED_PARAM_WIFI] 
                    && appOLEDData.wifiCloudConnected[APP_OLED_PARAM_CLOUD]){
                oledb_displayOn();
                oledb_displayPicture(msgCloudConnected);
            }
            /* Display only Wi-Fi icon */
            else if(appOLEDData.wifiCloudConnected[APP_OLED_PARAM_WIFI] 
                    && !appOLEDData.wifiCloudConnected[APP_OLED_PARAM_CLOUD]){
                oledb_displayOn();
                oledb_displayPicture(msgWifiConnected);
            }
            /* Clear display */
            else{
                oledb_displayOff();
            }
            appOLEDData.state = APP_OLED_STATE_IDLE;
            break;
        }

        /* The default state should never be executed. */
        default:
        {
            /* TODO: Handle error in application's state machine. */
            break;
        }
    }
}


/*******************************************************************************
 End of File
 */